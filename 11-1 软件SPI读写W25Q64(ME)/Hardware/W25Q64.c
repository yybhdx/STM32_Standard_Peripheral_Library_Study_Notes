#include "stm32f10x.h" // Device header
#include "MySPI.h"
#include "W25Q64_Ins.h"

/*W25Q64初始化*/
void W25Q64_Init(void)
{
  /*初始化SPI*/
  MySPI_Init();
}

/*读取设备ID*/
/*因为计划这个函数有两个返回值，所以使用指针来实现多返回值，原来的返回值就不要了*/
/*MID:八位的厂商ID,DID:16位的设备ID*/
void W25Q64_ReadID(uint8_t *MID, uint16_t *DID)
{
  /*起始信号*/
  MYSPI_Start();

  /*交换发送一个字节9F*/
  /*抛砖引玉:抛过去9F的数据，代表读ID号的指令，
  从机收到读ID号的指令之后，就会严格按照手册里约定的规则来，下一次交换，就会把ID号返回给主机了*/
  /*由于交换接收没有意义，所以返回值就不要了*/
  // W25Q64_JEDEC_ID 0x9F                         /*读取JEDEC ID*/
  MySPI_SwapByte(W25Q64_JEDEC_ID);

  /*再来一次*/
  /*因为此时我的目的是接收，所以给它抛的东西就没有意义了
  我们可以随便给它抛一个垃圾，但一般为了体现素质，我们会给一个0XFF，这个0XFF没有意义
  它的目的，就是给对吗有意义的数据置换过来，置换之后，这个返回值就是我们想要的ID号了*/
  /*第一个置换的是厂商ID，我们把它存在MID指向的变量里*/
  // W25Q64_DUMMY_BYTE 0xFF /*用于数据交换*/
  *MID = MySPI_SwapByte(W25Q64_DUMMY_BYTE);

  /*之后，根据手册，我们再交换一次，之后收到的就是设备ID的高8位了*/
  /*所以我们再一次抛砖引玉，它返回的是设备ID的高8位*/
  /*我们把返回值存在DID指向的变量里*/
  // W25Q64_DUMMY_BYTE 0xFF /*用于数据交换*/
  *DID = MySPI_SwapByte(W25Q64_DUMMY_BYTE);

  /*虽然我们连续调用了两个相同的函数，但是它们的返回值并不是一样的，
  因为我们是在通讯，通讯是有时序的，不同时间调用相同的函数，它的意义就是不一样的*/

  /*之后继续，我们再复制一下，第三次交换，根据手册的规定，这时返回的是设备ID的低八位
  我们也把它存在DID里
  当然要想把两次的读取分别放在DID的高八位和低八位，我们需要在第一次读取之后*/
  *DID <<= 8; // 把第一次读到的数据运到DID的高8位去

  /*之后，第二次读取，需要变为|=，不能直接写等于，否则高8位又置零0了*/
  /*这样我们的两个ID号就读好了*/
  // W25Q64_DUMMY_BYTE 0xFF /*用于数据交换*/
  *DID |= MySPI_SwapByte(W25Q64_DUMMY_BYTE);

  /*最后，时序结束，我们来个MySPI_Stop*/
  /*这样，获取ID号的时序就拼接完成了*/
  /*总的来说，就是，起始，交换，交换，交换，最后停止
  最后交换每个字节的意义，查看指令表就很容易理解了*/
  MYSPI_Stop();
}

/* W25Q64写使能 */
void W25Q64_WriteEnabl(void)
{
  /*发送起始信号*/
  MYSPI_Start();

  /*交换发送一个字节*/
  /*W25Q64规定SPI起始后的第一个字节，都是指令码*/
  // W25Q64_WRITE_ENABLE 0x06  /*写使能，执行写入/擦除操作前必须发送*/
  MySPI_SwapByte(W25Q64_WRITE_ENABLE);

  /*这个指令后续不需要跟任何数据
  直接发送结束信号就行了*/
  MYSPI_Stop();
}

/*等待BUSY*/
void W25Q64_WaitBusy(void)
{
  uint32_t Timeout = 0;
  /*发送起始信号*/
  MYSPI_Start();

  /*读状态寄存器1*/
  // W25Q64_READ_STATUS_REGISTER_1 0x05 /*读取状态寄存器1?*/
  MySPI_SwapByte(W25Q64_READ_STATUS_REGISTER_1);

  /*接收数据*/
  /*返回值是状态寄存器1，我们把它&0X01，用掩码取出最低位
  如果它==0X01，就是BUSY为1,如果BUSY为1，就会进入循环，再次读出一次状态寄存器，继续判断
  直到BUSY为0，跳出循环
  这就是利用连续读出状态寄存器，实现等待BUSY的功能*/
  /*进入while死循环进行等待
  为了防止一直BUSY导致程序卡死，可以设置一个变量，每次执行一次while循环，变量就-1*/
  Timeout = 10000;
  while ((MySPI_SwapByte(W25Q64_READ_STATUS_REGISTER_1) & 0X01) == 0X01)
  {
    Timeout--;
    if (Timeout == 0)
    {
      /*在BREAK之前，也可以跳到自定义的错误处理函数 这个看自己的需求加就行*/
      break;
    }
  }

  /*最后我们来个STOP终止时序*/
  MYSPI_Stop();
}

/*页编程函数*/
/*我们调用这个函数，给一个指定的起始地址，再给要写入的数组和数量，他就能帮我们写入数据了*/
/*格式是:先发一个指令码02，再发3个字节的地址(因为地址是24位)，
之后继续发送DataByte1,DataByte2,DataByte3,最大是DataByte256
如果继续发送，那么就会覆盖DataByte1*/

/*uint32_t Address代表指令码*/
/*uint8_t *DataArray代表指定的地址*/
/*如果我们只想指定地址写一个字节，就是Data就行了
但是我们一般存储的东西比较多，每次都调用存储一个字节，效率太低
所以我们可以通过指针传递一个数组DataArray,数据类定义为指针*/
/*由于W25A65的地址需要24位 由于只有8位 16位 32位的变量类型，所以我们使用32位来存储*/

/*最后再加一个uint16_t Count，表示一次写多少个*/
/*另外，由于这个页编程，它一次性写入数据的数量范围是0-256，所以Count要定义成16位的
如果只定义八位的那么就只能存储0-255*/
void W25Q64_PageProgram(uint32_t Address, uint8_t *DataArray, uint16_t Count)
{
  uint16_t i;

  /*由于W25Q64要求每次写入操作前，必须进行写使能，在我们这里
  涉及写入操作的时序有扇区擦除和页编程，既然每次写入之前都必须得写使能
  那么我们直接在函数中自带一个写使能，省的我们在每次调用的时候加写使能的代码了*/
  /*这个写使能，仅对之后跟随的一条时序有效，一条时序结束后，会顺手关门
  所以我们在每次写之前都加一条写使能，写完之后就不用再写失能了，这就是写使能的操作*/
  W25Q64_WriteEnabl();

  /*函数内部，拼接时序*/

  /*先发送起始信号*/
  MYSPI_Start();

  /*再发送指令*/
  /*W25Q64_PAGE_PROGRAM 0x02      页编程，可写入1-256字节数据*/
  MySPI_SwapByte(W25Q64_PAGE_PROGRAM);

  /*之后，我们还要继续交换发送三个字节的地址
  所以，再复制三遍*/
  /*地址是高位字节先发送的，所以第一次发的，是Address,3个字节里的最高位字节*/
  /*我们直接把Address右移16位，如果地址是0X123456，右移16位，就是0X12了，就是最高位的字节*/
  MySPI_SwapByte(Address >> 16);

  /* 第二次，我们把address右移八位,如果地址是0X123456，右移8位，就是0X1234了
  但是交换字节函数只能接收8位数据，所以高位舍弃，实际发送0X34，就是中间的字节*/
  MySPI_SwapByte(Address >> 8);

  /*第三次，我们直接把Address放进去，如果地址是0X123456，舍弃高位，实际发送0X56，就是最低位的字节*/
  /*这样连续发送24位地址就完成了*/
  MySPI_SwapByte(Address);

  /*根据手册，地址发完，就可以依次发送写入的数据了*/

  /*我们复制，继续交换发送*/
  /*第一次写入的，是DataArray,的第0个数据*/
  /*第二次写入的，是DataArray,的第1个数据，这样一次来进行，即可在指定地址开始，写入多个字节*/
  /*那我们要写入Conunt个数据，来个循环就再合适不过了*/
  /*循环Count次*/
  for (i = 0; i < Count; i++)
  {
    /*每个循环交换发送一次，对于DataArray索引为i*/
    MySPI_SwapByte(DataArray[i]);
  }

  /*发送停止信号*/
  MYSPI_Stop();

  /*选择事后等待*/
  W25Q64_WaitBusy();
}

/*扇区擦除*/
/*调用这个函数，指定地址的所在扇区就会被擦除*/
/*其他的擦除就是非常类似的*/
/*根据手册，要实现扇区擦除，要先发送指令20，再发送3个字节的地址就行了
这样指定地址所在的扇区就会被擦除*/
/*由于W25A65的地址需要24位 由于只有8位 16位 32位的变量类型，所以我们使用32位来存储*/
void W25Q64_SectorErase(uint32_t Address)
{

  /*由于W25Q64要求每次写入操作前，必须进行写使能，在我们这里
  涉及写入操作的时序有扇区擦除和页编程，既然每次写入之前都必须得写使能
  那么我们直接在函数中自带一个写使能，省的我们在每次调用的时候加写使能的代码了*/
  W25Q64_WriteEnabl();

  /*先发送起始信号*/
  MYSPI_Start();

  /*发送指令*/
  // W25Q64_SECTOR_ERASE_4KB 0x20 /*擦除4KB扇区*/
  MySPI_SwapByte(W25Q64_SECTOR_ERASE_4KB);

  /*地址是高位字节先发送(由SPI协议的时序决定)的，所以第一次发的，是Address,3个字节里的最高位字节*/
  /*我们直接把Address右移16位，如果地址是0X123456，右移16位，就是0X12了，就是最高位的字节*/
  MySPI_SwapByte(Address >> 16);

  /* 第二次，我们把address右移八位,如果地址是0X123456，右移8位，就是0X1234了
  但是交换字节函数只能接收8位数据，所以高位舍弃，实际发送0X34，就是中间的字节*/
  MySPI_SwapByte(Address >> 8);

  /*第三次，我们直接把Address放进去，如果地址是0X123456，舍弃高位，实际发送0X56，就是最低位的字节*/
  /*这样连续发送24位地址就完成了*/
  MySPI_SwapByte(Address);

  /*发送停止信号*/
  MYSPI_Stop();

  /*之后扇区擦除，也来个事后等待
  读取数据时事前时候都不需要等待了，因为每次耗时操作之后，我们都已经等过了
  所以调用W25Q64_ReadData时肯定不会忙*/
  /*选择事后等待*/
  W25Q64_WaitBusy();
}

/*读取数据*/
/*我们调用这个函数，给一个指定的起始地址(Address)，
再给接受读取数据的数组(DataArray)和数量(Count)，它就能帮我们读取数据了*/
/*流程是:交换发送指令03，再发送3个字节地址
随后转入接收，就可以依次接收数据了*/
/*参数与页编辑函数W25Q64_PageProgram一样
只不过，我们这个读数据的数组uint8_t *DataArray是输出参数
读到的数据通过数组输出
页编辑函数W25Q64_PageProgram的数组是输入参数，要写的数据通过数组输入*/
/*我们读取的数据没有页的限制，所以读取的Count，范围可以非常大*/
/*16位数据最大是65535，可能不够
我们改成32位的类型就没问题了*/
void W25Q64_ReadData(uint32_t Address, uint8_t *DataArray, uint32_t Count)
{
  /*函数的内容前面的一段和页编辑函数W25Q64_PageProgram一样*/

  uint32_t i;
  /*函数内部，拼接时序*/

  /*先发送起始信号*/
  MYSPI_Start();

  /*再发送指令*/
  /*W25Q64_PAGE_PROGRAM 0x02      页编程，可写入1-256字节数据*/
  // W25Q64_READ_DATA 0x03               /*标准读取数据*/
  MySPI_SwapByte(W25Q64_READ_DATA);

  /*之后，我们还要继续交换发送三个字节的地址
  所以，再复制三遍*/
  /*地址是高位字节先发送的，所以第一次发的，是Address,3个字节里的最高位字节*/
  /*我们直接把Address右移16位，如果地址是0X123456，右移16位，就是0X12了，就是最高位的字节*/
  MySPI_SwapByte(Address >> 16);

  /* 第二次，我们把address右移八位,如果地址是0X123456，右移8位，就是0X1234了
  但是交换字节函数只能接收8位数据，所以高位舍弃，实际发送0X34，就是中间的字节*/
  MySPI_SwapByte(Address >> 8);

  /*第三次，我们直接把Address放进去，如果地址是0X123456，舍弃高位，实际发送0X56，就是最低位的字节*/
  /*这样连续发送24位地址就完成了*/
  MySPI_SwapByte(Address);

  /*根据协议规定，从这里开始，我们就开始读了*/
  /*发送0XFF置换回有用的数据
  它的返回值就是有用的数据
  我们把数据放到DataArray的第0个位置*/
  /*在每次调用交换读取之后，存储器芯片内部地址指针自动自增
  依次返回指定地址开始，往后线性区域地址下的数据*/
  /*在STM32里，我们肯定也是把这一个个的数据流，依次存在一个线性地址的数组里
  这个过程，我们还是套一个for循环
  循环Count次，每次循环，读取一个字节，依次放在DataArray的第i个位置
  之后就能想读多少读多少了*/
  // W25Q64_DUMMY_BYTE 0xFF /*用于数据交换*/
  for (i = 0; i < Count; i++)
  {
    DataArray[i] = MySPI_SwapByte(W25Q64_DUMMY_BYTE);
  }

  /*读完之后来个STop
  这样读取数据的时序就完成了*/
  /*发送停止信号*/
  MYSPI_Stop();
  // DataArray[0] = MySPI_SwapByte(W25Q64_DUMMY_BYTE);

  // /*之后继续读 放到第1个位置和第2个位置*/
  // DataArray[1] = MySPI_SwapByte(W25Q64_DUMMY_BYTE);

  // /*之后继续读 放到第1个位置和第3个位置*/
  // DataArray[2] = MySPI_SwapByte(W25Q64_DUMMY_BYTE);
}

/*因为Flahs操作在写入操作结束后，芯片进入忙状态，不响应新的读写操作
所以我们可以在每次写操作时序结束后，调用一下WaitBusy
当然这里还涉及一个事前等待还是事后等待的考虑*/

/*事后等待*/
/*我们可以选择，在每次写入后都等BUSY清零了，再退出，
这样是最保险的，函数结束后，芯片肯定是不忙的状态。
这就是事后等待，就是写入后，立刻等待，不忙了再退出*/
/*事前等待*/
/*另外我们还可以选择事前等待，就是雪茹时序结束后，我们不进行等待，
而是在每次操作之前，在W25Q64_WriteEnabl();之前，uint16_t i;之后写入事前等待
我们只需要在每次写入之前等一下BUSY，不忙的事后，再写入，就没问题了,这就是事前等待
就是写入前，先等待，等不忙了，再写入*/

/*这两者的区别是
事后等待，最保险，在函数之外的地方，芯片肯定是不忙的状态
事前等待，效率会高一些，因为你写完之后不等，程序可以执行其他代码
那就正好利用执行其他代码的时间，来消耗我等待的时间
说不定我下次事前等待的事后，时间被执行其他代码耗过去了，我就不用等了*/
/*最后一个区别就是，事后等待，只需要在写入操作之后调用
而事前等待，在写入操作和读取操作之前，都得调用
因为在忙的时候，读取也是不行的，所以如果采取事前等待
那么读取操作之前，也得等待。这就是两种等待方式的区别
可以根据自己的喜好和需求来选择事前等待还是事后等待*/
